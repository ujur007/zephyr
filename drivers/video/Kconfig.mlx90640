## drivers/video/Kconfig.mlx90640
```kconfig
# OV2640

# Copyright (c) 2021 Antmicro <www.antmicro.com>
# SPDX-License-Identifier: Apache-2.0

config VIDEO_MLX90640
	bool "MLX90640 thermal imaging sensor"
	select I2C
	depends on DT_HAS_MELEXIS_MLX90640_ENABLED
	default y
	help
	  Enable driver for MLX90640 thermal image sensor device.
```

## dts/bindings/video/melexis,mlx90640.yaml
```yaml
# Copyright (c) 2021 Antmicro <www.antmicro.com>
# SPDX-License-Identifier: Apache-2.0

description: mlx90640 thermal imaging sensor

compatible: "melexis,mlx90640"

include: i2c-device.yaml
```
